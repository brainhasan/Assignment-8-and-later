## base_external/configs/aesd_qemu_defconfig
```kconfig
BR2_TARGET_ROOTFS_EXT2=y
BR2_TARGET_ROOTFS_EXT2_4=y
BR2_PACKAGE_AESD_ASSIGNMENTS=y
BR2_PACKAGE_LDD=y
```

## base_external/package/ldd/Config.in
```kconfig
config BR2_PACKAGE_LDD
        depends on BR2_LINUX_KERNEL
	bool "LDD"
	help
	  Linux Device Drivers repository for AESD assignments.
```
